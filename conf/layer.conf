## conf/layer.conf
```bitbake
# We have a conf and classes directory, append to BBPATH
BBPATH .= ":${LAYERDIR}"

BBFILES += "${LAYERDIR}/recipes*/*/*.bb ${LAYERDIR}/recipes*/*/*.bbappend ${LAYERDIR}/images/*.bb"

BBFILE_COLLECTIONS += "meta-webthings"
BBFILE_PATTERN_meta-webthings := "^${LAYERDIR}/"
BBFILE_PRIORITY_meta-webthings = "12"

LAYERSERIES_COMPAT_meta-webthings = "zeus dunfell hardknott gatesgarth"
```
